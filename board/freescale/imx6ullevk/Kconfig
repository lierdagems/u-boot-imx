## board/freescale/imx6ullevk/Kconfig
```kconfig
if TARGET_IMX6ULL_EVK

config SYS_BOARD
	default "imx6ullevk"

config SYS_VENDOR
	default "freescale"

config SYS_CONFIG_NAME
	default "imx6ullevk"

endif
```

## configs/imx6ull-evk-unvs-nand_defconfig
```kconfig
CONFIG_ARM=y
CONFIG_ARCH_MX6=y
CONFIG_TARGET_IMX6ULL_EVK=y
CONFIG_SYS_EXTRA_OPTIONS="IMX_CONFIG=board/freescale/imx6ullevk/imximage.cfg,SYS_BOOT_NAND"
CONFIG_CMD_GPIO=y
```
